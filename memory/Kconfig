## memory/Kconfig
```kconfig
#
# Copyright (C) 2024 Xiaomi Corporation
#
# Licensed under the Apache License, Version 2.0 (the "License");
# you may not use this file except in compliance with the License.
# You may obtain a copy of the License at
#
#      http://www.apache.org/licenses/LICENSE-2.0
#
# Unless required by applicable law or agreed to in writing, software
# distributed under the License is distributed on an "AS IS" BASIS,
# WITHOUT WARRANTIES OR CONDITIONS OF ANY KIND, either express or implied.
# See the License for the specific language governing permissions and
# limitations under the License.
#

config WASM_MEMORY_OPERATIONS
    bool "Enable custom memory operations"
    default n
    ---help---
        This option enables custom memory operations for WebAssembly, which can be used to extend or modify the behavior of memory handling in WebAssembly environments.

if WASM_MEMORY_OPERATIONS

config WASM_MEMORY_REGISTER_ACCESS
    bool "Enable register access"
    default n
    ---help---
        This option enables the ability to access CPU registers in WebAssembly environments by
        custom bounds checks by WAMR

if WASM_MEMORY_REGISTER_ACCESS

config WASM_MEMORY_REGISTER_REGION_START
    hex "Start address of the register region"
    default 0x20000000
    ---help---
        The start address of the register region for bounds checking.
        Default value is for BL616 chip.

config WASM_MEMORY_REGISTER_REGION_END
    hex "End address of the register region"
    default 0x20072000
    ---help---
        The end address of the register region for bounds checking.
        Default value is for BL616 chip.

endif # WASM_MEMORY_REGISTER_ACCESS

endif # WASM_MEMORY_OPERATIONS
```
